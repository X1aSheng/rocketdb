## zephyr/Kconfig
```kconfig
# RocketDB Kconfig options for Zephyr build system
# SPDX-License-Identifier: MIT

menuconfig ROCKETDB
	bool "RocketDB — Zero-allocation Flash Storage Engine"
	help
	  Dual-mode embedded flash database engine providing KVDB
	  (log-structured key-value store with GC and wear-leveling)
	  and TSDB (ring-buffer time-series store).  Zero malloc.
	  Operates on raw NOR flash via the Zephyr flash API.

if ROCKETDB

config ROCKETDB_KVDB
	bool "KVDB key-value engine"
	default y
	help
	  Build the log-structured key-value database engine.

config ROCKETDB_TSDB
	bool "TSDB time-series engine"
	default y
	help
	  Build the ring-buffer time-series database engine.

config ROCKETDB_MAX_KEY_LEN
	int "Maximum KVDB key length (bytes)"
	range 1 32
	default 32
	help
	  Maximum key length for KVDB operations (1..32).
	  RocketDB is designed for short embedded configuration keys.
	  Map longer application paths to short keys before storage.

config ROCKETDB_MAX_VAL_LEN
	int "Maximum KVDB value length (bytes)"
	range 1 65535
	default 4095
	help
	  Maximum value length per KV record.

config ROCKETDB_MAX_TS_DATA_LEN
	int "Maximum TSDB data payload length (0 = physical limit)"
	range 0 65535
	default 0
	help
	  Maximum data payload per TSDB record.
	  0 means use the physical limit (sector_size minus headers).

config ROCKETDB_STACK_BUF_SIZE
	int "Stack buffer size for merged writes"
	range 32 512
	default 64
	help
	  Records smaller than this are assembled in a stack buffer
	  and written in one flash operation.  Must be >= 32.

config ROCKETDB_GC_GARBAGE_PCT
	int "GC Phase 2 garbage percentage threshold"
	range 0 100
	default 20
	help
	  Sectors with garbage% below this threshold are not considered
	  as GC candidates.  Lower values make GC more aggressive.

config ROCKETDB_GC_WEAR_THRESHOLD
	int "Wear-leveling trigger threshold"
	range 0 10000
	default 100
	help
	  When max_ec - min_ec exceeds this value, Phase 4 wear
	  leveling activates to redistribute wear.

config ROCKETDB_KV_CACHE_SIZE
	int "KVDB key-to-address cache size (slots)"
	range 0 255
	default 0
	help
	  Number of cache slots for KVDB key-to-address lookup.
	  0 disables the cache.  64 slots (~1 KB) recommended for
	  production workloads.  Each slot is 16 bytes.

config ROCKETDB_BLOOM_BITS
	int "Per-sector bloom filter width (bits)"
	range 0 1024
	default 0
	help
	  Hash bucket bitmap width per sector.  256 bits (32 bytes)
	  is recommended for W25QXX-class workloads; 0 disables.
	  When > 0 must be a power of 2.

config ROCKETDB_FLASH_PAGE_SIZE
	int "Flash physical page size (bytes, 0=no restriction)"
	range 0 4096
	default 0
	help
	  When > 0 the engine ensures no write crosses a page boundary.
	  W25QXX-series parts use 256-byte pages.  Must be a power
	  of 2 when > 0.

config ROCKETDB_GC_W_GARBAGE
	int "GC score weight: garbage percentage"
	range 0 100
	default 7
	help
	  Weight of the garbage-percentage term in the GC Phase 2
	  scored-selection formula.  Higher values favour throughput
	  (reclaim sectors with the most waste).

config ROCKETDB_GC_W_WEAR
	int "GC score weight: wear percentage"
	range 0 100
	default 3
	help
	  Weight of the wear-percentage term.  Higher values distribute
	  erase cycles more evenly, extending flash lifespan.

config ROCKETDB_GC_W_CAPACITY
	int "GC score weight: capacity utilisation"
	range 0 100
	default 1
	help
	  Weight of the capacity-utilisation term.  Higher values favour
	  sectors with low live-data occupancy (efficient reclaim).

config ROCKETDB_SHELL
	bool "RocketDB shell commands"
	depends on SHELL
	default n
	help
	  Reserved for future shell subcommands.  The current module does
	  not ship a shell implementation file, so leave this disabled.

endif # ROCKETDB
```
